/dts-v1/;
/plugin/;

/ {
	fragment@0 {
		target = <&i2c1>;
		__overlay__ {
			pinctrl-names = "default";
			pinctrl-0 = <&i2c1_pi_pins>;
			status = "okay";
			beepy_kbd: beepy_kbd@1f {
				compatible = "beepy-kbd";
				reg = <0x1F>;
				irq-gpio = <&pio 8 13 2>;
				interrupts = <8 13 2>;
				interrupt-parent = <&pio>;
				interrupt-controller;
			};
		};
	};
	__overrides__ {
		irq_pin = <&beepy_kbd>,"interrupts:0";
	};
};